## conf/layer.conf
```bitbake
# We have a conf and classes directory, add to BBPATH
BBPATH .= ":${LAYERDIR}"

# We have recipes-* directories, add to BBFILES
BBFILES += "${LAYERDIR}/recipes-*/*/*.bb \
            ${LAYERDIR}/recipes-*/*/*.bbappend"

BBFILE_COLLECTIONS += "meta-swupdate-custom"
BBFILE_PATTERN_meta-swupdate-custom = "^${LAYERDIR}/"
BBFILE_PRIORITY_meta-swupdate-custom = "6"

LAYERDEPENDS_meta-swupdate-custom = "core"
LAYERSERIES_COMPAT_meta-swupdate-custom = "warrior zeus"
```
